/*
 * Joseph's 2% Milk Keymap (23.07.02)
 *
 * Key Mapping:
 * Top: Play/Pause
 * Bottom: Next
 */

#include <behaviors.dtsi>
#include <dt-bindings/zmk/bt.h>
#include <dt-bindings/zmk/keys.h>

/ {
    keymap {
        compatible = "zmk,keymap";
        default_layer {
            bindings = <
                &kp C_NEXT
                &kp C_PLAY_PAUSE
            >;
        };
    };
};